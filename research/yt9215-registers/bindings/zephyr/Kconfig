## research/yt9215-registers/bindings/zephyr/Kconfig
```kconfig
# SPDX-License-Identifier: Apache-2.0

config YT921X
	bool "Motorcomm YT921x Ethernet switch register access"
	default y
	depends on DT_HAS_MOTORCOMM_YT921X_ENABLED
	select MDIO
	help
	  Register access, reset and identification for Motorcomm YT921x
	  Ethernet switches (YT9215, YT9218 and relatives) that are managed
	  over MDIO.

if YT921X

config YT921X_INIT_PRIORITY
	int "YT921x init priority"
	default 85
	help
	  Device init priority. It must be higher than the priority of the
	  MDIO controller the switch is attached to.

module = YT921X
module-str = yt921x
source "subsys/logging/Kconfig.template.log_config"

endif # YT921X
```

## research/yt9215-registers/bindings/zephyr/dts/bindings/ethernet/motorcomm,yt921x.yaml
```yaml
# SPDX-License-Identifier: Apache-2.0

description: |
  Motorcomm YT921x Gigabit Ethernet switch (YT9215S, YT9215SC, YT9215RB,
  YT9214NB, YT9213NB, YT9218N, YT9218MB) managed over MDIO.

  The node is a child of an MDIO controller. Its reg property is the MDIO
  address the switch answers on, which the board sets with a pin strap:

    &mdio0 {
        switch0: switch@1d {
            compatible = "motorcomm,yt921x";
            reg = <0x1d>;
            reset-gpios = <&gpio0 4 GPIO_ACTIVE_LOW>;
        };
    };

compatible: "motorcomm,yt921x"

include: base.yaml

on-bus: mdio

properties:
  reg:
    required: true
    description: MDIO address of the switch, 0x1d or 0x00.

  switch-id:
    type: int
    default: 0
    enum: [0, 1, 2, 3]
    description: |
      Switch ID. Up to four switches can share one MDIO address and are told
      apart by this number, which is part of every MDIO frame. The default of
      0 is what a board with a single switch uses.

  reset-gpios:
    type: phandle-array
    description: |
      GPIO wired to the reset pin of the switch. When present the pin is
      pulsed before the register reset.

  skip-reset:
    type: boolean
    description: |
      Do not reset the switch at init. Use it when a boot loader has already
      configured the switch and its state must be kept.
```
